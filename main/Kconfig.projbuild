## main/Kconfig.projbuild
```kconfig
menu "Levoit purifier"

    choice LEVOIT_MODEL
        prompt "Model"
        default LEVOIT_MODEL_CORE300S

        config LEVOIT_MODEL_CORE200S
            bool "Core 200S"
        config LEVOIT_MODEL_CORE300S
            bool "Core 300S"
        config LEVOIT_MODEL_CORE400S
            bool "Core 400S"
        config LEVOIT_MODEL_CORE600S
            bool "Core 600S"
        config LEVOIT_MODEL_SPROUT
            bool "Sprout"
        config LEVOIT_MODEL_EVERESTAIR
            bool "EverestAir"
    endchoice

    config LEVOIT_UART_TX_GPIO
        int "GPIO wired to the purifier controller's RX"
        default 16 if LEVOIT_MODEL_CORE200S
        default 22 if LEVOIT_MODEL_SPROUT
        default 17
        help
            The Core 200S uses 16. The Core 200S-P (hardware version 2.0) uses 17.

    config LEVOIT_UART_RX_GPIO
        int "GPIO wired to the purifier controller's TX"
        default 17 if LEVOIT_MODEL_CORE200S
        default 23 if LEVOIT_MODEL_SPROUT
        default 16
        help
            The Core 200S uses 17. The Core 200S-P (hardware version 2.0) uses 16.

    config LEVOIT_DISPLAY_SWITCH
        bool "Expose the display as a switch"
        default y
        help
            Apple Home shows it as an unnamed outlet tile. Turn off to leave it out.

    config LEVOIT_CHILD_LOCK_SWITCH
        bool "Expose child lock as a switch"
        default y
        help
            Apple Home shows it as an unnamed outlet tile. Turn off to leave it out.

    config LEVOIT_HTTP_OTA
        bool "Accept firmware over HTTP with the update token"
        default n
        help
            Adds POST /ota for tools/ota.sh: about four times faster than a
            Matter update, and it can downgrade. For development. Anyone who
            reads the token off the network can replace the firmware, so
            leave it off on purifiers you are not developing on.

    config LEVOIT_LOG_FRAMES
        bool "Log every serial frame to and from the purifier"
        default n
        help
            One hex line per frame, both directions. For working out a model or
            controller the firmware does not understand yet. Read it with
            tools/watch.sh. Fills the log quickly, so leave it off otherwise.

endmenu
```

## sdkconfig.defaults
```kconfig
CONFIG_IDF_TARGET="esp32"
CONFIG_ESPTOOLPY_FLASHSIZE_4MB=y
CONFIG_PARTITION_TABLE_CUSTOM=y
CONFIG_PARTITION_TABLE_CUSTOM_FILENAME="partitions.csv"
CONFIG_FREERTOS_UNICORE=y
CONFIG_COMPILER_OPTIMIZATION_SIZE=y
CONFIG_BOOTLOADER_APP_ROLLBACK_ENABLE=y
CONFIG_ESP_MAIN_TASK_STACK_SIZE=8192
CONFIG_UART_ISR_IN_IRAM=y

CONFIG_BT_ENABLED=y
CONFIG_BT_NIMBLE_ENABLED=y
CONFIG_BT_NIMBLE_ENABLE_CONN_REATTEMPT=n
CONFIG_BT_NIMBLE_MAX_CONNECTIONS=1
CONFIG_BT_NIMBLE_ROLE_CENTRAL=n
CONFIG_BT_NIMBLE_ROLE_OBSERVER=n
CONFIG_BTDM_CTRL_BLE_MAX_CONN=1
CONFIG_BTDM_CTRL_MODE_BLE_ONLY=y
CONFIG_ENABLE_CHIPOBLE=y
CONFIG_USE_BLE_ONLY_FOR_COMMISSIONING=y

CONFIG_ENABLE_WIFI_AP=n
CONFIG_ESP_WIFI_SOFTAP_SUPPORT=n
CONFIG_ESP_WIFI_IRAM_OPT=n
CONFIG_ESP_WIFI_RX_IRAM_OPT=n
CONFIG_LWIP_IPV6_AUTOCONFIG=y
CONFIG_LWIP_HOOK_IP6_ROUTE_DEFAULT=y
CONFIG_LWIP_HOOK_ND6_GET_GW_DEFAULT=y
CONFIG_LWIP_IPV6_NUM_ADDRESSES=6
CONFIG_LWIP_MAX_SOCKETS=16
CONFIG_LWIP_LOCAL_HOSTNAME="levoit-purifier"
CONFIG_MBEDTLS_HKDF_C=y

CONFIG_CUSTOM_COMMISSIONABLE_DATA_PROVIDER=y
CONFIG_DEVICE_VENDOR_ID=0xFFF1
CONFIG_DEVICE_PRODUCT_ID=0x8000
CONFIG_DEVICE_TYPE=45
CONFIG_ENABLE_COMMISSIONABLE_DEVICE_TYPE=y
CONFIG_ESP_MATTER_MAX_DYNAMIC_ENDPOINT_COUNT=6
CONFIG_ESP_MATTER_BINDING_TABLE_SIZE=1
CONFIG_MAX_GROUP_KEYS_PER_FABRIC=4
CONFIG_ENABLE_CHIP_SHELL=n
CONFIG_ENABLE_OTA_REQUESTOR=n

CONFIG_LOG_COLORS=n
CONFIG_CHIP_LOG_DEFAULT_LEVEL_EQUALS_LOG_DEFAULT_LEVEL=n
CONFIG_CHIP_LOG_DEFAULT_LEVEL_ERROR=y
```
